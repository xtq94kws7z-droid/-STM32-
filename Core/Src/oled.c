/**
 * oled.c - SSD1306 OLED 128x64 I2C 驱动
 * 使用软件 I2C (SoftI2C)
 */

#include "oled.h"
#include "soft_i2c.h"
#include "chinese_font.h"
#include <string.h>

#define OLED_DEV_ADDR  OLED_I2C_ADDR

/* 帧缓冲区: 128x64 / 8 = 1024 字节 */
uint8_t OLED_Buffer[OLED_WIDTH * OLED_HEIGHT / 8];

/* ========== 5x7 ASCII 字库 ========== */
static const uint8_t Font5x7[][5] = {
    {0x00,0x00,0x00,0x00,0x00},{0x00,0x00,0x5F,0x00,0x00},
    {0x00,0x07,0x00,0x07,0x00},{0x14,0x7F,0x14,0x7F,0x14},
    {0x24,0x2A,0x7F,0x2A,0x12},{0x23,0x13,0x08,0x64,0x62},
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    {0x08,0x08,0x2A,0x1C,0x08},
};

/* ========== 写命令/数据 ========== */
static void OLED_WriteCmd(uint8_t cmd)
{
    SoftI2C_WriteReg(OLED_DEV_ADDR, 0x00, cmd);
}

static void OLED_WriteData(uint8_t dat)
{
    SoftI2C_WriteMulti(OLED_DEV_ADDR, 0x40, &dat, 1);
}

/* ========== 初始化 ========== */
void OLED_Init(I2C_HandleTypeDef *hi2c)
{
    (void)hi2c;
    HAL_Delay(100);

    OLED_WriteCmd(0xAE);
    OLED_WriteCmd(0xD5); OLED_WriteCmd(0x80);
    OLED_WriteCmd(0xA8); OLED_WriteCmd(0x3F);
    OLED_WriteCmd(0xD3); OLED_WriteCmd(0x00);
    OLED_WriteCmd(0x40);
    OLED_WriteCmd(0x8D); OLED_WriteCmd(0x14);
    OLED_WriteCmd(0x20); OLED_WriteCmd(0x00);
    OLED_WriteCmd(0xA1);
    OLED_WriteCmd(0xC8);
    OLED_WriteCmd(0x81); OLED_WriteCmd(0xCF);
    OLED_WriteCmd(0xD9); OLED_WriteCmd(0xF1);
    OLED_WriteCmd(0xDB); OLED_WriteCmd(0x40);
    OLED_WriteCmd(0xA4);
    OLED_WriteCmd(0xA6);
    OLED_WriteCmd(0xAF);

    OLED_Clear();
    OLED_Update();
}

void OLED_Clear(void)
{
    uint16_t i;
    for (i = 0; i < sizeof(OLED_Buffer); i++)
        OLED_Buffer[i] = 0x00;
}

void OLED_Update(void)
{
    uint8_t page, col;

    for (page = 0; page < 8; page++)
    {
        OLED_WriteCmd(0xB0 + page);
        OLED_WriteCmd(0x00);
        OLED_WriteCmd(0x10);

        for (col = 0; col < OLED_WIDTH; col++)
        {
            OLED_WriteData(OLED_Buffer[col + page * OLED_WIDTH]);
        }
    }
}

void OLED_SetPixel(uint8_t x, uint8_t y, uint8_t color)
{
    if (x >= OLED_WIDTH || y >= OLED_HEIGHT) return;
    if (color)
        OLED_Buffer[x + (y / 8) * OLED_WIDTH] |= (uint8_t)(1 << (y % 8));
    else
        OLED_Buffer[x + (y / 8) * OLED_WIDTH] &= (uint8_t)~(1 << (y % 8));
}

void OLED_DrawChar(uint8_t x, uint8_t y, char ch)
{
    uint8_t i, j;
    if (ch < ' ' || ch > '~') ch = ' ';
    ch -= ' ';
    for (i = 0; i < 5; i++)
        for (j = 0; j < 7; j++)
            if (Font5x7[(uint8_t)ch][i] & (1 << j))
                OLED_SetPixel(x + i, y + j, 1);
}

void OLED_Print(uint8_t x, uint8_t y, const char *str)
{
    while (*str)
    {
        OLED_DrawChar(x, y, *str);
        x += 6;
        if (x > OLED_WIDTH - 6) { x = 0; y += 8; }
        str++;
    }
}

void OLED_DrawChinese(uint8_t x, uint8_t y, uint8_t index)
{
    uint8_t row, col;
    uint16_t line;
    const uint8_t *data;

    if (index >= CN_CHAR_COUNT) return;
    data = cn_font[index];

    for (row = 0; row < 16; row++)
    {
        line = ((uint16_t)data[row * 2] << 8) | data[row * 2 + 1];
        for (col = 0; col < 16; col++)
        {
            if (line & (0x8000 >> col))
                OLED_SetPixel(x + col, y + row, 1);
        }
    }
}
